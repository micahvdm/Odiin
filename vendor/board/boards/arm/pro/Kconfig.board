## vendor/board/boards/arm/pro/Kconfig.board
```kconfig
# nRF52840-M2 board configuration

# Copyright (c) 2020 makerdiary
# SPDX-License-Identifier: Apache-2.0

config BOARD_PRO
	bool "pro"
	depends on SOC_NRF52840_QIAA
```
